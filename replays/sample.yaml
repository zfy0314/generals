## replays/sample.yaml
```yaml
!!python/object:base.game.Board
board:
- - !!python/object:base.game.Tile
    army: 0
    is_city: 0
    is_general: 0
    is_mountain: 0
    owner: null
  - !!python/object:base.game.Tile
    army: 0
    is_city: 0
    is_general: 0
    is_mountain: 0
    owner: null
  - !!python/object:base.game.Tile
    army: 0
    is_city: 0
    is_general: 0
    is_mountain: 0
    owner: null
  - !!python/object:base.game.Tile
    army: 0
    is_city: 0
    is_general: 0
    is_mountain: 0
    owner: null
  - !!python/object:base.game.Tile
    army: 49
    is_city: 1
    is_general: 0
    is_mountain: 0
    owner: null
  - !!python/object:base.game.Tile
    army: 0
    is_city: 0
    is_general: 0
    is_mountain: 0
    owner: null
  - !!python/object:base.game.Tile
    army: 0
    is_city: 0
    is_general: 0
    is_mountain: 1
    owner: null
  - !!python/object:base.game.Tile
    army: 0
    is_city: 0
    is_general: 0
    is_mountain: 1
    owner: null
  - !!python/object:base.game.Tile
    army: 0
    is_city: 0
    is_general: 0
    is_mountain: 0
    owner: null
  - !!python/object:base.game.Tile
    army: 0
    is_city: 0
    is_general: 0
    is_mountain: 1
    owner: null
  - !!python/object:base.game.Tile
    army: 0
    is_city: 0
    is_general: 0
    is_mountain: 0
    owner: null
  - !!python/object:base.game.Tile
    army: 0
    is_city: 0
    is_general: 0
    is_mountain: 0
    owner: null
  - !!python/object:base.game.Tile
    army: 0
    is_city: 0
    is_general: 0
    is_mountain: 0
    owner: null
  - !!python/object:base.game.Tile
    army: 0
    is_city: 0
    is_general: 0
    is_mountain: 0
    owner: null
  - !!python/object:base.game.Tile
    army: 0
    is_city: 0
    is_general: 0
    is_mountain: 0
    owner: null
- - !!python/object:base.game.Tile
    army: 0
    is_city: 0
    is_general: 0
    is_mountain: 0
    owner: null
  - !!python/object:base.game.Tile
    army: 0
    is_city: 0
    is_general: 0
    is_mountain: 0
    owner: null
  - !!python/object:base.game.Tile
    army: 0
    is_city: 0
    is_general: 0
    is_mountain: 1
    owner: null
  - !!python/object:base.game.Tile
    army: 0
    is_city: 0
    is_general: 0
    is_mountain: 0
    owner: null
  - !!python/object:base.game.Tile
    army: 0
    is_city: 0
    is_general: 0
    is_mountain: 0
    owner: null
  - !!python/object:base.game.Tile
    army: 0
    is_city: 0
    is_general: 0
    is_mountain: 0
    owner: null
  - !!python/object:base.game.Tile
    army: 0
    is_city: 0
    is_general: 0
    is_mountain: 0
    owner: null
  - !!python/object:base.game.Tile
    army: 0
    is_city: 0
    is_general: 0
    is_mountain: 0
    owner: null
  - !!python/object:base.game.Tile
    army: 50
    is_city: 1
    is_general: 0
    is_mountain: 0
    owner: null
  - !!python/object:base.game.Tile
    army: 0
    is_city: 0
    is_general: 0
    is_mountain: 0
    owner: null
  - !!python/object:base.game.Tile
    army: 0
    is_city: 0
    is_general: 0
    is_mountain: 1
    owner: null
  - !!python/object:base.game.Tile
    army: 0
    is_city: 0
    is_general: 0
    is_mountain: 1
    owner: null
  - !!python/object:base.game.Tile
    army: 40
    is_city: 1
    is_general: 0
    is_mountain: 0
    owner: null
  - !!python/object:base.game.Tile
    army: 0
    is_city: 0
    is_general: 0
    is_mountain: 0
    owner: null
  - !!python/object:base.game.Tile
    army: 0
    is_city: 0
    is_general: 0
    is_mountain: 0
    owner: null
- - !!python/object:base.game.Tile
    army: 0
    is_city: 0
    is_general: 0
    is_mountain: 0
    owner: null
  - !!python/object:base.game.Tile
    army: 0
    is_city: 0
    is_general: 0
    is_mountain: 0
    owner: null
  - !!python/object:base.game.Tile
    army: 0
    is_city: 0
    is_general: 0
    is_mountain: 0
    owner: null
  - !!python/object:base.game.Tile
    army: 0
    is_city: 0
    is_general: 0
    is_mountain: 1
    owner: null
  - !!python/object:base.game.Tile
    army: 0
    is_city: 0
    is_general: 0
    is_mountain: 0
    owner: null
  - !!python/object:base.game.Tile
    army: 0
    is_city: 0
    is_general: 0
    is_mountain: 0
    owner: null
  - !!python/object:base.game.Tile
    army: 0
    is_city: 0
    is_general: 0
    is_mountain: 0
    owner: null
  - !!python/object:base.game.Tile
    army: 0
    is_city: 0
    is_general: 0
    is_mountain: 1
    owner: null
  - !!python/object:base.game.Tile
    army: 0
    is_city: 0
    is_general: 0
    is_mountain: 0
    owner: null
  - !!python/object:base.game.Tile
    army: 0
    is_city: 0
    is_general: 0
    is_mountain: 1
    owner: null
  - !!python/object:base.game.Tile
    army: 0
    is_city: 0
    is_general: 0
    is_mountain: 1
    owner: null
  - !!python/object:base.game.Tile
    army: 0
    is_city: 0
    is_general: 0
    is_mountain: 0
    owner: null
  - !!python/object:base.game.Tile
    army: 0
    is_city: 0
    is_general: 0
    is_mountain: 0
    owner: null
  - !!python/object:base.game.Tile
    army: 0
    is_city: 0
    is_general: 0
    is_mountain: 1
    owner: null
  - !!python/object:base.game.Tile
    army: 0
    is_city: 0
    is_general: 0
    is_mountain: 1
    owner: null
- - !!python/object:base.game.Tile
    army: 0
    is_city: 0
    is_general: 0
    is_mountain: 0
    owner: null
  - !!python/object:base.game.Tile
    army: 0
    is_city: 0
    is_general: 0
    is_mountain: 0
    owner: null
  - !!python/object:base.game.Tile
    army: 0
    is_city: 0
    is_general: 0
    is_mountain: 1
    owner: null
  - !!python/object:base.game.Tile
    army: 0
    is_city: 0
    is_general: 0
    is_mountain: 0
    owner: null
  - !!python/object:base.game.Tile
    army: 46
    is_city: 1
    is_general: 0
    is_mountain: 0
    owner: null
  - !!python/object:base.game.Tile
    army: 0
    is_city: 0
    is_general: 0
    is_mountain: 0
    owner: null
  - !!python/object:base.game.Tile
    army: 0
    is_city: 0
    is_general: 0
    is_mountain: 1
    owner: null
  - !!python/object:base.game.Tile
    army: 0
    is_city: 0
    is_general: 0
    is_mountain: 1
    owner: null
  - !!python/object:base.game.Tile
    army: 0
    is_city: 0
    is_general: 0
    is_mountain: 0
    owner: null
  - !!python/object:base.game.Tile
    army: 0
    is_city: 0
    is_general: 0
    is_mountain: 0
    owner: null
  - !!python/object:base.game.Tile
    army: 0
    is_city: 0
    is_general: 0
    is_mountain: 1
    owner: null
  - !!python/object:base.game.Tile
    army: 0
    is_city: 0
    is_general: 0
    is_mountain: 0
    owner: null
  - !!python/object:base.game.Tile
    army: 46
    is_city: 1
    is_general: 0
    is_mountain: 0
    owner: null
  - !!python/object:base.game.Tile
    army: 0
    is_city: 0
    is_general: 0
    is_mountain: 1
    owner: null
  - !!python/object:base.game.Tile
    army: 0
    is_city: 0
    is_general: 0
    is_mountain: 0
    owner: null
- - !!python/object:base.game.Tile
    army: 0
    is_city: 0
    is_general: 0
    is_mountain: 0
    owner: null
  - !!python/object:base.game.Tile
    army: 0
    is_city: 0
    is_general: 0
    is_mountain: 0
    owner: null
  - !!python/object:base.game.Tile
    army: 0
    is_city: 0
    is_general: 0
    is_mountain: 0
    owner: null
  - !!python/object:base.game.Tile
    army: 0
    is_city: 0
    is_general: 0
    is_mountain: 1
    owner: null
  - !!python/object:base.game.Tile
    army: 0
    is_city: 0
    is_general: 0
    is_mountain: 0
    owner: null
  - !!python/object:base.game.Tile
    army: 0
    is_city: 0
    is_general: 0
    is_mountain: 0
    owner: null
  - !!python/object:base.game.Tile
    army: 0
    is_city: 0
    is_general: 0
    is_mountain: 0
    owner: null
  - !!python/object:base.game.Tile
    army: 0
    is_city: 0
    is_general: 0
    is_mountain: 0
    owner: null
  - !!python/object:base.game.Tile
    army: 45
    is_city: 1
    is_general: 0
    is_mountain: 0
    owner: null
  - !!python/object:base.game.Tile
    army: 0
    is_city: 0
    is_general: 0
    is_mountain: 0
    owner: null
  - !!python/object:base.game.Tile
    army: 0
    is_city: 0
    is_general: 0
    is_mountain: 0
    owner: null
  - !!python/object:base.game.Tile
    army: 0
    is_city: 0
    is_general: 0
    is_mountain: 1
    owner: null
  - !!python/object:base.game.Tile
    army: 0
    is_city: 0
    is_general: 0
    is_mountain: 0
    owner: null
  - !!python/object:base.game.Tile
    army: 0
    is_city: 0
    is_general: 0
    is_mountain: 1
    owner: null
  - !!python/object:base.game.Tile
    army: 0
    is_city: 0
    is_general: 0
    is_mountain: 0
    owner: null
- - !!python/object:base.game.Tile
    army: 0
    is_city: 0
    is_general: 0
    is_mountain: 0
    owner: null
  - !!python/object:base.game.Tile
    army: 0
    is_city: 0
    is_general: 0
    is_mountain: 0
    owner: null
  - !!python/object:base.game.Tile
    army: 0
    is_city: 0
    is_general: 0
    is_mountain: 1
    owner: null
  - !!python/object:base.game.Tile
    army: 50
    is_city: 1
    is_general: 0
    is_mountain: 0
    owner: null
  - !!python/object:base.game.Tile
    army: 0
    is_city: 0
    is_general: 0
    is_mountain: 0
    owner: null
  - !!python/object:base.game.Tile
    army: 0
    is_city: 0
    is_general: 0
    is_mountain: 1
    owner: null
  - !!python/object:base.game.Tile
    army: 0
    is_city: 0
    is_general: 0
    is_mountain: 0
    owner: null
  - !!python/object:base.game.Tile
    army: 0
    is_city: 0
    is_general: 0
    is_mountain: 0
    owner: null
  - !!python/object:base.game.Tile
    army: 0
    is_city: 0
    is_general: 0
    is_mountain: 0
    owner: null
  - !!python/object:base.game.Tile
    army: 0
    is_city: 0
    is_general: 0
    is_mountain: 0
    owner: null
  - !!python/object:base.game.Tile
    army: 0
    is_city: 0
    is_general: 0
    is_mountain: 0
    owner: null
  - !!python/object:base.game.Tile
    army: 0
    is_city: 0
    is_general: 0
    is_mountain: 1
    owner: null
  - !!python/object:base.game.Tile
    army: 0
    is_city: 0
    is_general: 0
    is_mountain: 0
    owner: null
  - !!python/object:base.game.Tile
    army: 0
    is_city: 0
    is_general: 0
    is_mountain: 0
    owner: null
  - !!python/object:base.game.Tile
    army: 0
    is_city: 0
    is_general: 0
    is_mountain: 0
    owner: null
- - !!python/object:base.game.Tile
    army: 0
    is_city: 0
    is_general: 0
    is_mountain: 0
    owner: null
  - !!python/object:base.game.Tile
    army: 42
    is_city: 1
    is_general: 0
    is_mountain: 0
    owner: null
  - !!python/object:base.game.Tile
    army: 0
    is_city: 0
    is_general: 0
    is_mountain: 1
    owner: null
  - !!python/object:base.game.Tile
    army: 0
    is_city: 0
    is_general: 0
    is_mountain: 0
    owner: null
  - !!python/object:base.game.Tile
    army: 0
    is_city: 0
    is_general: 0
    is_mountain: 1
    owner: null
  - !!python/object:base.game.Tile
    army: 0
    is_city: 0
    is_general: 0
    is_mountain: 1
    owner: null
  - !!python/object:base.game.Tile
    army: 42
    is_city: 1
    is_general: 0
    is_mountain: 0
    owner: null
  - !!python/object:base.game.Tile
    army: 0
    is_city: 0
    is_general: 0
    is_mountain: 0
    owner: null
  - !!python/object:base.game.Tile
    army: 0
    is_city: 0
    is_general: 0
    is_mountain: 1
    owner: null
  - !!python/object:base.game.Tile
    army: 49
    is_city: 1
    is_general: 0
    is_mountain: 0
    owner: null
  - !!python/object:base.game.Tile
    army: 0
    is_city: 0
    is_general: 0
    is_mountain: 1
    owner: null
  - !!python/object:base.game.Tile
    army: 0
    is_city: 0
    is_general: 0
    is_mountain: 0
    owner: null
  - !!python/object:base.game.Tile
    army: 0
    is_city: 0
    is_general: 0
    is_mountain: 0
    owner: null
  - !!python/object:base.game.Tile
    army: 0
    is_city: 0
    is_general: 0
    is_mountain: 1
    owner: null
  - !!python/object:base.game.Tile
    army: 0
    is_city: 0
    is_general: 0
    is_mountain: 1
    owner: null
- - !!python/object:base.game.Tile
    army: 0
    is_city: 0
    is_general: 0
    is_mountain: 1
    owner: null
  - !!python/object:base.game.Tile
    army: 1
    is_city: 0
    is_general: 0
    is_mountain: 0
    owner: player2
  - !!python/object:base.game.Tile
    army: 0
    is_city: 0
    is_general: 0
    is_mountain: 1
    owner: null
  - !!python/object:base.game.Tile
    army: 0
    is_city: 0
    is_general: 0
    is_mountain: 0
    owner: null
  - !!python/object:base.game.Tile
    army: 0
    is_city: 0
    is_general: 0
    is_mountain: 0
    owner: null
  - !!python/object:base.game.Tile
    army: 0
    is_city: 0
    is_general: 0
    is_mountain: 0
    owner: null
  - !!python/object:base.game.Tile
    army: 0
    is_city: 0
    is_general: 0
    is_mountain: 0
    owner: null
  - !!python/object:base.game.Tile
    army: 0
    is_city: 0
    is_general: 0
    is_mountain: 0
    owner: null
  - !!python/object:base.game.Tile
    army: 0
    is_city: 0
    is_general: 0
    is_mountain: 0
    owner: null
  - !!python/object:base.game.Tile
    army: 0
    is_city: 0
    is_general: 0
    is_mountain: 0
    owner: null
  - !!python/object:base.game.Tile
    army: 0
    is_city: 0
    is_general: 0
    is_mountain: 1
    owner: null
  - !!python/object:base.game.Tile
    army: 0
    is_city: 0
    is_general: 0
    is_mountain: 0
    owner: null
  - !!python/object:base.game.Tile
    army: 0
    is_city: 0
    is_general: 0
    is_mountain: 0
    owner: null
  - !!python/object:base.game.Tile
    army: 0
    is_city: 0
    is_general: 0
    is_mountain: 0
    owner: null
  - !!python/object:base.game.Tile
    army: 0
    is_city: 0
    is_general: 0
    is_mountain: 1
    owner: null
- - !!python/object:base.game.Tile
    army: 1
    is_city: 0
    is_general: 0
    is_mountain: 0
    owner: player2
  - !!python/object:base.game.Tile
    army: 1
    is_city: 0
    is_general: 0
    is_mountain: 0
    owner: player2
  - !!python/object:base.game.Tile
    army: 0
    is_city: 0
    is_general: 0
    is_mountain: 1
    owner: null
  - !!python/object:base.game.Tile
    army: 0
    is_city: 0
    is_general: 0
    is_mountain: 0
    owner: null
  - !!python/object:base.game.Tile
    army: 0
    is_city: 0
    is_general: 0
    is_mountain: 0
    owner: null
  - !!python/object:base.game.Tile
    army: 0
    is_city: 0
    is_general: 0
    is_mountain: 1
    owner: null
  - !!python/object:base.game.Tile
    army: 0
    is_city: 0
    is_general: 0
    is_mountain: 0
    owner: null
  - !!python/object:base.game.Tile
    army: 0
    is_city: 0
    is_general: 0
    is_mountain: 0
    owner: null
  - !!python/object:base.game.Tile
    army: 0
    is_city: 0
    is_general: 0
    is_mountain: 0
    owner: null
  - !!python/object:base.game.Tile
    army: 0
    is_city: 0
    is_general: 0
    is_mountain: 1
    owner: null
  - !!python/object:base.game.Tile
    army: 0
    is_city: 0
    is_general: 0
    is_mountain: 0
    owner: null
  - !!python/object:base.game.Tile
    army: 0
    is_city: 0
    is_general: 0
    is_mountain: 0
    owner: null
  - !!python/object:base.game.Tile
    army: 0
    is_city: 0
    is_general: 0
    is_mountain: 0
    owner: null
  - !!python/object:base.game.Tile
    army: 0
    is_city: 0
    is_general: 0
    is_mountain: 0
    owner: null
  - !!python/object:base.game.Tile
    army: 0
    is_city: 0
    is_general: 0
    is_mountain: 0
    owner: null
- - !!python/object:base.game.Tile
    army: 1
    is_city: 0
    is_general: 0
    is_mountain: 0
    owner: player2
  - !!python/object:base.game.Tile
    army: 0
    is_city: 0
    is_general: 0
    is_mountain: 0
    owner: null
  - !!python/object:base.game.Tile
    army: 0
    is_city: 0
    is_general: 0
    is_mountain: 0
    owner: null
  - !!python/object:base.game.Tile
    army: 0
    is_city: 0
    is_general: 0
    is_mountain: 1
    owner: null
  - !!python/object:base.game.Tile
    army: 0
    is_city: 0
    is_general: 0
    is_mountain: 0
    owner: null
  - !!python/object:base.game.Tile
    army: 40
    is_city: 1
    is_general: 0
    is_mountain: 0
    owner: null
  - !!python/object:base.game.Tile
    army: 0
    is_city: 0
    is_general: 0
    is_mountain: 0
    owner: null
  - !!python/object:base.game.Tile
    army: 0
    is_city: 0
    is_general: 0
    is_mountain: 1
    owner: null
  - !!python/object:base.game.Tile
    army: 0
    is_city: 0
    is_general: 0
    is_mountain: 0
    owner: null
  - !!python/object:base.game.Tile
    army: 0
    is_city: 0
    is_general: 0
    is_mountain: 0
    owner: null
  - !!python/object:base.game.Tile
    army: 0
    is_city: 0
    is_general: 0
    is_mountain: 0
    owner: null
  - !!python/object:base.game.Tile
    army: 0
    is_city: 0
    is_general: 0
    is_mountain: 1
    owner: null
  - !!python/object:base.game.Tile
    army: 0
    is_city: 0
    is_general: 0
    is_mountain: 1
    owner: null
  - !!python/object:base.game.Tile
    army: 0
    is_city: 0
    is_general: 0
    is_mountain: 1
    owner: null
  - !!python/object:base.game.Tile
    army: 49
    is_city: 1
    is_general: 0
    is_mountain: 0
    owner: null
- - !!python/object:base.game.Tile
    army: 1
    is_city: 0
    is_general: 0
    is_mountain: 0
    owner: player2
  - !!python/object:base.game.Tile
    army: 0
    is_city: 0
    is_general: 0
    is_mountain: 1
    owner: null
  - !!python/object:base.game.Tile
    army: 0
    is_city: 0
    is_general: 0
    is_mountain: 1
    owner: null
  - !!python/object:base.game.Tile
    army: 0
    is_city: 0
    is_general: 0
    is_mountain: 0
    owner: null
  - !!python/object:base.game.Tile
    army: 0
    is_city: 0
    is_general: 0
    is_mountain: 0
    owner: null
  - !!python/object:base.game.Tile
    army: 0
    is_city: 0
    is_general: 0
    is_mountain: 0
    owner: null
  - !!python/object:base.game.Tile
    army: 7
    is_city: 0
    is_general: 1
    is_mountain: 0
    owner: player1
  - !!python/object:base.game.Tile
    army: 0
    is_city: 0
    is_general: 0
    is_mountain: 0
    owner: null
  - !!python/object:base.game.Tile
    army: 0
    is_city: 0
    is_general: 0
    is_mountain: 0
    owner: null
  - !!python/object:base.game.Tile
    army: 0
    is_city: 0
    is_general: 0
    is_mountain: 0
    owner: null
  - !!python/object:base.game.Tile
    army: 0
    is_city: 0
    is_general: 0
    is_mountain: 1
    owner: null
  - !!python/object:base.game.Tile
    army: 0
    is_city: 0
    is_general: 0
    is_mountain: 0
    owner: null
  - !!python/object:base.game.Tile
    army: 0
    is_city: 0
    is_general: 0
    is_mountain: 0
    owner: null
  - !!python/object:base.game.Tile
    army: 0
    is_city: 0
    is_general: 0
    is_mountain: 0
    owner: null
  - !!python/object:base.game.Tile
    army: 0
    is_city: 0
    is_general: 0
    is_mountain: 0
    owner: null
- - !!python/object:base.game.Tile
    army: 1
    is_city: 0
    is_general: 0
    is_mountain: 0
    owner: player2
  - !!python/object:base.game.Tile
    army: 0
    is_city: 0
    is_general: 0
    is_mountain: 1
    owner: null
  - !!python/object:base.game.Tile
    army: 0
    is_city: 0
    is_general: 0
    is_mountain: 0
    owner: null
  - !!python/object:base.game.Tile
    army: 0
    is_city: 0
    is_general: 0
    is_mountain: 1
    owner: null
  - !!python/object:base.game.Tile
    army: 0
    is_city: 0
    is_general: 0
    is_mountain: 0
    owner: null
  - !!python/object:base.game.Tile
    army: 0
    is_city: 0
    is_general: 0
    is_mountain: 0
    owner: null
  - !!python/object:base.game.Tile
    army: 1
    is_city: 0
    is_general: 0
    is_mountain: 0
    owner: player1
  - !!python/object:base.game.Tile
    army: 0
    is_city: 0
    is_general: 0
    is_mountain: 0
    owner: null
  - !!python/object:base.game.Tile
    army: 0
    is_city: 0
    is_general: 0
    is_mountain: 0
    owner: null
  - !!python/object:base.game.Tile
    army: 0
    is_city: 0
    is_general: 0
    is_mountain: 1
    owner: null
  - !!python/object:base.game.Tile
    army: 0
    is_city: 0
    is_general: 0
    is_mountain: 0
    owner: null
  - !!python/object:base.game.Tile
    army: 0
    is_city: 0
    is_general: 0
    is_mountain: 1
    owner: null
  - !!python/object:base.game.Tile
    army: 47
    is_city: 1
    is_general: 0
    is_mountain: 0
    owner: null
  - !!python/object:base.game.Tile
    army: 49
    is_city: 1
    is_general: 0
    is_mountain: 0
    owner: null
  - !!python/object:base.game.Tile
    army: 0
    is_city: 0
    is_general: 0
    is_mountain: 0
    owner: null
- - !!python/object:base.game.Tile
    army: 7
    is_city: 0
    is_general: 1
    is_mountain: 0
    owner: player2
  - !!python/object:base.game.Tile
    army: 49
    is_city: 1
    is_general: 0
    is_mountain: 0
    owner: null
  - !!python/object:base.game.Tile
    army: 0
    is_city: 0
    is_general: 0
    is_mountain: 0
    owner: null
  - !!python/object:base.game.Tile
    army: 0
    is_city: 0
    is_general: 0
    is_mountain: 1
    owner: null
  - !!python/object:base.game.Tile
    army: 0
    is_city: 0
    is_general: 0
    is_mountain: 1
    owner: null
  - !!python/object:base.game.Tile
    army: 0
    is_city: 0
    is_general: 0
    is_mountain: 0
    owner: null
  - !!python/object:base.game.Tile
    army: 1
    is_city: 0
    is_general: 0
    is_mountain: 0
    owner: player1
  - !!python/object:base.game.Tile
    army: 1
    is_city: 0
    is_general: 0
    is_mountain: 0
    owner: player1
  - !!python/object:base.game.Tile
    army: 1
    is_city: 0
    is_general: 0
    is_mountain: 0
    owner: player1
  - !!python/object:base.game.Tile
    army: 1
    is_city: 0
    is_general: 0
    is_mountain: 0
    owner: player1
  - !!python/object:base.game.Tile
    army: 1
    is_city: 0
    is_general: 0
    is_mountain: 0
    owner: player1
  - !!python/object:base.game.Tile
    army: 0
    is_city: 0
    is_general: 0
    is_mountain: 0
    owner: null
  - !!python/object:base.game.Tile
    army: 0
    is_city: 0
    is_general: 0
    is_mountain: 0
    owner: null
  - !!python/object:base.game.Tile
    army: 0
    is_city: 0
    is_general: 0
    is_mountain: 0
    owner: null
  - !!python/object:base.game.Tile
    army: 0
    is_city: 0
    is_general: 0
    is_mountain: 1
    owner: null
- - !!python/object:base.game.Tile
    army: 41
    is_city: 1
    is_general: 0
    is_mountain: 0
    owner: null
  - !!python/object:base.game.Tile
    army: 0
    is_city: 0
    is_general: 0
    is_mountain: 0
    owner: null
  - !!python/object:base.game.Tile
    army: 0
    is_city: 0
    is_general: 0
    is_mountain: 0
    owner: null
  - !!python/object:base.game.Tile
    army: 0
    is_city: 0
    is_general: 0
    is_mountain: 1
    owner: null
  - !!python/object:base.game.Tile
    army: 0
    is_city: 0
    is_general: 0
    is_mountain: 0
    owner: null
  - !!python/object:base.game.Tile
    army: 0
    is_city: 0
    is_general: 0
    is_mountain: 0
    owner: null
  - !!python/object:base.game.Tile
    army: 0
    is_city: 0
    is_general: 0
    is_mountain: 0
    owner: null
  - !!python/object:base.game.Tile
    army: 0
    is_city: 0
    is_general: 0
    is_mountain: 0
    owner: null
  - !!python/object:base.game.Tile
    army: 0
    is_city: 0
    is_general: 0
    is_mountain: 1
    owner: null
  - !!python/object:base.game.Tile
    army: 0
    is_city: 0
    is_general: 0
    is_mountain: 0
    owner: null
  - !!python/object:base.game.Tile
    army: 0
    is_city: 0
    is_general: 0
    is_mountain: 0
    owner: null
  - !!python/object:base.game.Tile
    army: 0
    is_city: 0
    is_general: 0
    is_mountain: 0
    owner: null
  - !!python/object:base.game.Tile
    army: 0
    is_city: 0
    is_general: 0
    is_mountain: 1
    owner: null
  - !!python/object:base.game.Tile
    army: 0
    is_city: 0
    is_general: 0
    is_mountain: 0
    owner: null
  - !!python/object:base.game.Tile
    army: 0
    is_city: 0
    is_general: 0
    is_mountain: 0
    owner: null
- - !!python/object:base.game.Tile
    army: 0
    is_city: 0
    is_general: 0
    is_mountain: 0
    owner: null
  - !!python/object:base.game.Tile
    army: 0
    is_city: 0
    is_general: 0
    is_mountain: 0
    owner: null
  - !!python/object:base.game.Tile
    army: 0
    is_city: 0
    is_general: 0
    is_mountain: 1
    owner: null
  - !!python/object:base.game.Tile
    army: 0
    is_city: 0
    is_general: 0
    is_mountain: 0
    owner: null
  - !!python/object:base.game.Tile
    army: 0
    is_city: 0
    is_general: 0
    is_mountain: 0
    owner: null
  - !!python/object:base.game.Tile
    army: 0
    is_city: 0
    is_general: 0
    is_mountain: 1
    owner: null
  - !!python/object:base.game.Tile
    army: 0
    is_city: 0
    is_general: 0
    is_mountain: 0
    owner: null
  - !!python/object:base.game.Tile
    army: 0
    is_city: 0
    is_general: 0
    is_mountain: 0
    owner: null
  - !!python/object:base.game.Tile
    army: 0
    is_city: 0
    is_general: 0
    is_mountain: 0
    owner: null
  - !!python/object:base.game.Tile
    army: 0
    is_city: 0
    is_general: 0
    is_mountain: 1
    owner: null
  - !!python/object:base.game.Tile
    army: 0
    is_city: 0
    is_general: 0
    is_mountain: 0
    owner: null
  - !!python/object:base.game.Tile
    army: 0
    is_city: 0
    is_general: 0
    is_mountain: 1
    owner: null
  - !!python/object:base.game.Tile
    army: 0
    is_city: 0
    is_general: 0
    is_mountain: 1
    owner: null
  - !!python/object:base.game.Tile
    army: 0
    is_city: 0
    is_general: 0
    is_mountain: 0
    owner: null
  - !!python/object:base.game.Tile
    army: 0
    is_city: 0
    is_general: 0
    is_mountain: 0
    owner: null
cities: !!set
  ? !!python/tuple
  - 0
  - 4
  : null
  ? !!python/tuple
  - 1
  - 8
  : null
  ? !!python/tuple
  - 1
  - 12
  : null
  ? !!python/tuple
  - 3
  - 4
  : null
  ? !!python/tuple
  - 3
  - 12
  : null
  ? !!python/tuple
  - 4
  - 8
  : null
  ? !!python/tuple
  - 5
  - 3
  : null
  ? !!python/tuple
  - 6
  - 1
  : null
  ? !!python/tuple
  - 6
  - 6
  : null
  ? !!python/tuple
  - 6
  - 9
  : null
  ? !!python/tuple
  - 9
  - 5
  : null
  ? !!python/tuple
  - 9
  - 14
  : null
  ? !!python/tuple
  - 11
  - 12
  : null
  ? !!python/tuple
  - 11
  - 13
  : null
  ? !!python/tuple
  - 12
  - 1
  : null
  ? !!python/tuple
  - 13
  - 0
  : null
city_ratio: 0.1
generals:
  player1: !!python/tuple
  - 10
  - 6
  player2: !!python/tuple
  - 12
  - 0
height: 15
human: true
lands:
  player1: !!set
    ? !!python/tuple
    - 10
    - 6
    : null
    ? !!python/tuple
    - 11
    - 6
    : null
    ? !!python/tuple
    - 12
    - 6
    : null
    ? !!python/tuple
    - 12
    - 7
    : null
    ? !!python/tuple
    - 12
    - 8
    : null
    ? !!python/tuple
    - 12
    - 9
    : null
    ? !!python/tuple
    - 12
    - 10
    : null
  player2: !!set
    ? !!python/tuple
    - 7
    - 1
    : null
    ? !!python/tuple
    - 8
    - 0
    : null
    ? !!python/tuple
    - 8
    - 1
    : null
    ? !!python/tuple
    - 9
    - 0
    : null
    ? !!python/tuple
    - 10
    - 0
    : null
    ? !!python/tuple
    - 11
    - 0
    : null
    ? !!python/tuple
    - 12
    - 0
    : null
mountain_ratio: 0.3
mountains: !!set
  ? !!python/tuple
  - 0
  - 6
  : null
  ? !!python/tuple
  - 0
  - 7
  : null
  ? !!python/tuple
  - 0
  - 9
  : null
  ? !!python/tuple
  - 1
  - 2
  : null
  ? !!python/tuple
  - 1
  - 10
  : null
  ? !!python/tuple
  - 1
  - 11
  : null
  ? !!python/tuple
  - 2
  - 3
  : null
  ? !!python/tuple
  - 2
  - 7
  : null
  ? !!python/tuple
  - 2
  - 9
  : null
  ? !!python/tuple
  - 2
  - 10
  : null
  ? !!python/tuple
  - 2
  - 13
  : null
  ? !!python/tuple
  - 2
  - 14
  : null
  ? !!python/tuple
  - 3
  - 2
  : null
  ? !!python/tuple
  - 3
  - 6
  : null
  ? !!python/tuple
  - 3
  - 7
  : null
  ? !!python/tuple
  - 3
  - 10
  : null
  ? !!python/tuple
  - 3
  - 13
  : null
  ? !!python/tuple
  - 4
  - 3
  : null
  ? !!python/tuple
  - 4
  - 11
  : null
  ? !!python/tuple
  - 4
  - 13
  : null
  ? !!python/tuple
  - 5
  - 2
  : null
  ? !!python/tuple
  - 5
  - 5
  : null
  ? !!python/tuple
  - 5
  - 11
  : null
  ? !!python/tuple
  - 6
  - 2
  : null
  ? !!python/tuple
  - 6
  - 4
  : null
  ? !!python/tuple
  - 6
  - 5
  : null
  ? !!python/tuple
  - 6
  - 8
  : null
  ? !!python/tuple
  - 6
  - 10
  : null
  ? !!python/tuple
  - 6
  - 13
  : null
  ? !!python/tuple
  - 6
  - 14
  : null
  ? !!python/tuple
  - 7
  - 0
  : null
  ? !!python/tuple
  - 7
  - 2
  : null
  ? !!python/tuple
  - 7
  - 10
  : null
  ? !!python/tuple
  - 7
  - 14
  : null
  ? !!python/tuple
  - 8
  - 2
  : null
  ? !!python/tuple
  - 8
  - 5
  : null
  ? !!python/tuple
  - 8
  - 9
  : null
  ? !!python/tuple
  - 9
  - 3
  : null
  ? !!python/tuple
  - 9
  - 7
  : null
  ? !!python/tuple
  - 9
  - 11
  : null
  ? !!python/tuple
  - 9
  - 12
  : null
  ? !!python/tuple
  - 9
  - 13
  : null
  ? !!python/tuple
  - 10
  - 1
  : null
  ? !!python/tuple
  - 10
  - 2
  : null
  ? !!python/tuple
  - 10
  - 10
  : null
  ? !!python/tuple
  - 11
  - 1
  : null
  ? !!python/tuple
  - 11
  - 3
  : null
  ? !!python/tuple
  - 11
  - 9
  : null
  ? !!python/tuple
  - 11
  - 11
  : null
  ? !!python/tuple
  - 12
  - 3
  : null
  ? !!python/tuple
  - 12
  - 4
  : null
  ? !!python/tuple
  - 12
  - 14
  : null
  ? !!python/tuple
  - 13
  - 3
  : null
  ? !!python/tuple
  - 13
  - 8
  : null
  ? !!python/tuple
  - 13
  - 12
  : null
  ? !!python/tuple
  - 14
  - 2
  : null
  ? !!python/tuple
  - 14
  - 5
  : null
  ? !!python/tuple
  - 14
  - 9
  : null
  ? !!python/tuple
  - 14
  - 11
  : null
  ? !!python/tuple
  - 14
  - 12
  : null
moves:
  player1:
  - null
  - null
  - null
  - null
  - null
  - null
  - null
  - !!python/tuple
    - !!python/tuple
      - 10
      - 6
    - !!python/tuple
      - 11
      - 6
    - false
  - !!python/tuple
    - !!python/tuple
      - 11
      - 6
    - !!python/tuple
      - 12
      - 6
    - false
  - !!python/tuple
    - !!python/tuple
      - 12
      - 6
    - !!python/tuple
      - 12
      - 7
    - false
  - !!python/tuple
    - !!python/tuple
      - 12
      - 7
    - !!python/tuple
      - 12
      - 8
    - false
  - !!python/tuple
    - !!python/tuple
      - 12
      - 8
    - !!python/tuple
      - 12
      - 9
    - false
  - !!python/tuple
    - !!python/tuple
      - 12
      - 9
    - !!python/tuple
      - 12
      - 10
    - false
  player2:
  - null
  - null
  - null
  - null
  - null
  - null
  - null
  - !!python/tuple
    - !!python/tuple
      - 12
      - 0
    - !!python/tuple
      - 11
      - 0
    - false
  - !!python/tuple
    - !!python/tuple
      - 11
      - 0
    - !!python/tuple
      - 10
      - 0
    - false
  - !!python/tuple
    - !!python/tuple
      - 10
      - 0
    - !!python/tuple
      - 9
      - 0
    - false
  - !!python/tuple
    - !!python/tuple
      - 9
      - 0
    - !!python/tuple
      - 8
      - 0
    - false
  - !!python/tuple
    - !!python/tuple
      - 8
      - 0
    - !!python/tuple
      - 8
      - 1
    - false
  - !!python/tuple
    - !!python/tuple
      - 8
      - 1
    - !!python/tuple
      - 7
      - 1
    - false
name: configs/humans_2.yaml
players_classes:
  player1: players.player_human.player
  player2: players.player_human.player
round: 14
size: 225
status:
  player1:
    army: 13
    land: 7
  player2:
    army: 13
    land: 7
vis:
  player1: !!set
    ? !!python/tuple
    - 9
    - 5
    : null
    ? !!python/tuple
    - 9
    - 6
    : null
    ? !!python/tuple
    - 9
    - 7
    : null
    ? !!python/tuple
    - 10
    - 5
    : null
    ? !!python/tuple
    - 10
    - 6
    : null
    ? !!python/tuple
    - 10
    - 7
    : null
    ? !!python/tuple
    - 11
    - 5
    : null
    ? !!python/tuple
    - 11
    - 6
    : null
    ? !!python/tuple
    - 11
    - 7
    : null
    ? !!python/tuple
    - 11
    - 8
    : null
    ? !!python/tuple
    - 11
    - 9
    : null
    ? !!python/tuple
    - 11
    - 10
    : null
    ? !!python/tuple
    - 11
    - 11
    : null
    ? !!python/tuple
    - 12
    - 5
    : null
    ? !!python/tuple
    - 12
    - 6
    : null
    ? !!python/tuple
    - 12
    - 7
    : null
    ? !!python/tuple
    - 12
    - 8
    : null
    ? !!python/tuple
    - 12
    - 9
    : null
    ? !!python/tuple
    - 12
    - 10
    : null
    ? !!python/tuple
    - 12
    - 11
    : null
    ? !!python/tuple
    - 13
    - 5
    : null
    ? !!python/tuple
    - 13
    - 6
    : null
    ? !!python/tuple
    - 13
    - 7
    : null
    ? !!python/tuple
    - 13
    - 8
    : null
    ? !!python/tuple
    - 13
    - 9
    : null
    ? !!python/tuple
    - 13
    - 10
    : null
    ? !!python/tuple
    - 13
    - 11
    : null
  player2: !!set
    ? !!python/tuple
    - 6
    - 0
    : null
    ? !!python/tuple
    - 6
    - 1
    : null
    ? !!python/tuple
    - 6
    - 2
    : null
    ? !!python/tuple
    - 7
    - 0
    : null
    ? !!python/tuple
    - 7
    - 1
    : null
    ? !!python/tuple
    - 7
    - 2
    : null
    ? !!python/tuple
    - 8
    - 0
    : null
    ? !!python/tuple
    - 8
    - 1
    : null
    ? !!python/tuple
    - 8
    - 2
    : null
    ? !!python/tuple
    - 9
    - 0
    : null
    ? !!python/tuple
    - 9
    - 1
    : null
    ? !!python/tuple
    - 9
    - 2
    : null
    ? !!python/tuple
    - 10
    - 0
    : null
    ? !!python/tuple
    - 10
    - 1
    : null
    ? !!python/tuple
    - 11
    - 0
    : null
    ? !!python/tuple
    - 11
    - 1
    : null
    ? !!python/tuple
    - 12
    - 0
    : null
    ? !!python/tuple
    - 12
    - 1
    : null
    ? !!python/tuple
    - 13
    - 0
    : null
    ? !!python/tuple
    - 13
    - 1
    : null
wasted: 0
width: 15
```
